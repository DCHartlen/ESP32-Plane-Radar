#include "hardware/display_font.h"

#include <lgfx/v1/lgfx_fonts.hpp>

#include "hardware/display.h"

// Generated by scripts/build_vlw_font.py, embedded via board_build.embed_files.
extern "C" {
extern const uint8_t _binary_data_ui_font_tag_vlw_start[] asm(
    "_binary_data_ui_font_tag_vlw_start");
extern const uint8_t _binary_data_ui_font_tag_vlw_end[] asm(
    "_binary_data_ui_font_tag_vlw_end");
extern const uint8_t _binary_data_ui_font_small_vlw_start[] asm(
    "_binary_data_ui_font_small_vlw_start");
extern const uint8_t _binary_data_ui_font_small_vlw_end[] asm(
    "_binary_data_ui_font_small_vlw_end");
extern const uint8_t _binary_data_ui_font_large_vlw_start[] asm(
    "_binary_data_ui_font_large_vlw_start");
extern const uint8_t _binary_data_ui_font_large_vlw_end[] asm(
    "_binary_data_ui_font_large_vlw_end");
}

namespace {

struct VlwFile {
  const uint8_t* start;
  const uint8_t* end;
  /** fontHeight() at text size 1; measured in displayFontInit(). */
  int native_height;
};

/** Smallest first. The tag file is sized for kAircraftTagLabelHeightPx. */
VlwFile s_vlw[] = {
    {_binary_data_ui_font_tag_vlw_start, _binary_data_ui_font_tag_vlw_end, 0},
    {_binary_data_ui_font_small_vlw_start, _binary_data_ui_font_small_vlw_end, 0},
    {_binary_data_ui_font_large_vlw_start, _binary_data_ui_font_large_vlw_end, 0},
};
constexpr int kVlwCount = sizeof(s_vlw) / sizeof(s_vlw[0]);

const lgfx::GFXfont& kBitmapFallback = fonts::FreeSansBold24pt7b;

bool s_vlw_ok = false;

/** Which VLW each drawing surface holds; the font pointer detects a later setFont(). */
struct LoadedFont {
  const lgfx::LGFXBase* gfx = nullptr;
  const lgfx::IFont* font = nullptr;
  int index = -1;
};
constexpr int kMaxSurfaces = 4;
LoadedFont s_loaded[kMaxSurfaces];

LoadedFont& loadedSlot(const lgfx::LGFXBase& gfx) {
  for (auto& slot : s_loaded) {
    if (slot.gfx == &gfx) {
      return slot;
    }
  }
  for (auto& slot : s_loaded) {
    if (slot.gfx == nullptr) {
      slot.gfx = &gfx;
      return slot;
    }
  }
  // More surfaces than expected: share the last slot (it just reloads more often).
  s_loaded[kMaxSurfaces - 1] = LoadedFont{&gfx, nullptr, -1};
  return s_loaded[kMaxSurfaces - 1];
}

bool loadVlw(lgfx::LGFXBase& gfx, int index) {
  LoadedFont& slot = loadedSlot(gfx);
  if (slot.index == index && slot.font != nullptr && gfx.getFont() == slot.font) {
    return true;
  }
  if (!gfx.loadFont(s_vlw[index].start, lgfx::IFont::font_type_t::ft_vlw)) {
    slot.font = nullptr;
    slot.index = -1;
    return false;
  }
  slot.font = gfx.getFont();
  slot.index = index;
  return true;
}

/** Text size that makes the (truncating) fontHeight() land on height_px. */
float sizeForHeight(int height_px, int native_height) {
  return (static_cast<float>(height_px) + 0.5f) / static_cast<float>(native_height);
}

}  // namespace

bool displayFontInit() {
  s_vlw_ok = true;
  for (int i = 0; i < kVlwCount; ++i) {
    if (s_vlw[i].end <= s_vlw[i].start || !loadVlw(canvas, i)) {
      s_vlw_ok = false;
      break;
    }
    canvas.setTextSize(1);
    s_vlw[i].native_height = canvas.fontHeight();
    Serial.printf("VLW font %d: line height %d px\n", i, s_vlw[i].native_height);
  }
  if (!s_vlw_ok) {
    Serial.println("Smooth font load failed — using bitmap fallback");
  }
  return s_vlw_ok;
}

bool displayFontIsSmooth() { return s_vlw_ok; }

void displayFontApply(lgfx::LGFXBase& gfx, int height_px) {
  if (height_px < 1) {
    height_px = 1;
  }
  if (s_vlw_ok) {
    // A file at the height, or 1 px under it (the font's line heights go up in steps of
    // 2), is drawn unscaled: LovyanGFX scales down by dropping glyph pixels, so this is
    // sharper. (It's barely faster; text costs ~1 µs per fill call, row and edge pixel.)
    for (int i = 0; i < kVlwCount; ++i) {
      const int native = s_vlw[i].native_height;
      if (native <= height_px && native >= height_px - 1 && loadVlw(gfx, i)) {
        gfx.setTextSize(1);
        return;
      }
    }
    int index = kVlwCount - 1;
    for (int i = 0; i < kVlwCount; ++i) {
      if (s_vlw[i].native_height >= height_px) {
        index = i;
        break;
      }
    }
    if (loadVlw(gfx, index)) {
      gfx.setTextSize(sizeForHeight(height_px, s_vlw[index].native_height));
      return;
    }
  }
  gfx.setFont(&kBitmapFallback);
  gfx.setTextSize(1);
  gfx.setTextSize(sizeForHeight(height_px, gfx.fontHeight()));
}
